#ifdef ZILPZALP_BLE_FLAG
#include <behaviors.dtsi>
#include <dt-bindings/zmk/keys.h>
#include <dt-bindings/zmk/bt.h>
#include <dt-bindings/zmk/outputs.h>
#endif

#include "base_abyss.h"

// abyss key numbers
//  ___________________________   __________________________
// /  0  |  1  |  2  |  3  \     /  4  |  5  |  6  |  7  \
// |  8  |  9  | 10  | 11  | 12 /\ 13  | 14  | 15  | 16  | 17 |
// \ 18  | 19  | 20  /     \ 21  | 22  | 23  /
//   \ 24  | 25  /           \ 26  | 27  /
//   --------------           --------------

/ {

    keymap {
        compatible = "zmk,keymap";

        default {
            label = "DEF";

            bindings = <
                               &kp W          &kp E          &kp R         &kp T         &kp Z         &kp U          &kp I         &kp O
                               &hl LALT S     &hl LGUI D    &hl LSHFT F    &hl RALT G    &hr RALT N     &hr RSHFT J    &hr RGUI K     &hr LALT L    
                    &hl LCTRL A   &kp C       &kp V         &kp B     &my_lt NUM X &my_lt NAV SPACE &my_lt SYM BACKSPACE &my_lt FUN H   &kp M   &comsem   &dotcol   &hr RCTRL P
                                                            
            >;
        };
        numbers {
            label = "NUM";

            bindings = <
                                  &kp TAB            &kp LG(M)             &none              &kp LC(UP)        &none           &kp N7         &kp N8         &kp N9
                                  &hl LALT KP_MINUS &hl LGUI KP_ASTERISK &hl LSHFT KP_SLASH &kp RALT       &none          &kp N4         &kp N5         &kp N6        
                      &hl LCTRL KP_PLUS     &none    &none     &none         &trans         &trans      &none          &kp N0         &kp N1         &kp N2         &kp N3  &none
                                                            
            >;
        };
        navigation {
            label = "NAV";

            bindings = <
                               &ipad_tile_fullscreen          &ipad_tile_left          &ipad_tile_right  &kp C_VOL_DN   &kp C_VOL_UP     &kp C_PLAY_PAUSE  &kp LESS_THAN &kp GREATER_THAN
                               &kp LA(LC(LG(UP_ARROW)))       &sk LGUI       &sk LSHFT       &kp LG(C)   &kp C_MUTE     &kp LEFT       &kp DOWN       &kp UP         
                  &kp LA(LC(LG(M)))       &kp LA(RC(RG(LEFT)))       &kp LA(LC(LG(DOWN)))      &kp LA(LC(LG(RIGHT)))     &kp LG(V)          &trans         &kp MINUS         &kp PLUS    &kp HOME       &kp LEFT      &kp DOWN  &kp RIGHT
                                                           
            >;
        };
        symbols {
            label = "SYM";

            bindings = <
                               &kp LBRC       &kp RBRC       &kp LPAR          &kp RPAR       &none          &none          &none          &none
                               &kp AT         &kp HASH       &kp DOLLAR        &none          &none          &kp AMPERSAND  &kp ASTERISK   &kp PERCENT    
               &kp EXCL        &kp GRAVE      &kp DQT        &kp UNDERSCORE    &kp TILDE      &trans         &trans         &trans    &kp BACKSLASH  &kp PIPE       &kp EQUAL  &kp CARET

            >;
         };
#ifdef ZILPZALP_BLE_FLAG
        function {
            label = "FUN";

            bindings = <
                                    &kp SQT    &kp SEMICOLON   &kp LEFT_BRACKET &kp RIGHT_BRACKET     &kp RIGHT_BRACKET         &bt BT_SEL 1          &bt BT_SEL 2         &bt BT_CLR_ALL  
                                    &trans      &trans         &out OUT_TOG         &kp BACKSLASH     &kp F11        &kp F4         &kp F5         &kp F6         
                   &kp LC(LG(Q))       &trans          &trans          &none  &bt BT_CLR     &bt BT_NXT          &trans         &trans             &kp F1         &kp F2         &kp F3  &kp F10
                                                             
            >;
#endif
#ifndef ZILPZALP_BLE_FLAG
        function {
            label = "FUN";

            bindings = <
                                    &kp SQT        &kp SEMICOLON &kp LEFT_BRACKET    &kp RIGHT_BRACKET         &kp F10        &kp F7         &kp F8         &kp F9
                                    &none          &none         &none      &kp BACKSLASH          &kp F11       &kp F4        &kp F5        &kp F6         
                    &kp LC(LG(Q))     &bt BT_SEL 1          &bt BT_SEL 2         &bt BT_SEL 3          &trans       &bt BT_NXT       &kp F12        &none       &kp F1         &kp F2         &kp F3   &bt BT_CLR 
                                                           
            >;
           
         
#endif
        };

    };
};

//     __________________________  __________________________
//    /     1  |  2  |  3  |  4  \/   5 |   6 |   7 |   8    \
// | 10  | 11  | 12  | 13  | 14  ||  15 |  16 |  17 |  18 | 19  |
//    \    20  | 21  | 22  |     ||     |  23 |  24 |  25   /
//                \    26  | 27  /\  28 |  29    /
//                 --------------  --------------


